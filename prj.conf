## CMakeLists.txt
```
cmake_minimum_required(VERSION 3.20.0)

find_package(Zephyr REQUIRED HINTS $ENV{ZEPHYR_BASE})
project(nrf52840_rtos_ttn_abp)

FILE(GLOB app_sources src/*.c)
target_sources(app PRIVATE ${app_sources})
```

## prj.conf
```kconfig
# Debugger Support
CONFIG_CONSOLE=y
CONFIG_SERIAL=y
CONFIG_UART_CONSOLE=n

# RTT Segger Support
CONFIG_RTT_CONSOLE=y
CONFIG_USE_SEGGER_RTT=y

# Communication Bus Support
CONFIG_GPIO=y
CONFIG_SPI=y
CONFIG_I2C=y

# RTC Support
CONFIG_RTC=y
CONFIG_COUNTER=y
CONFIG_COUNTER_MAXIM_DS3231=y

# LoRa Support
CONFIG_LORA=y

# LoRaWAN Support
CONFIG_LORAWAN=y
CONFIG_HAS_SEMTECH_LORAMAC=y
CONFIG_LORAMAC_REGION_EU868=y
CONFIG_LORAWAN_SYSTEM_MAX_RX_ERROR=100

# Flash Memory Support
CONFIG_NVS=y
CONFIG_FLASH=y
CONFIG_FLASH_PAGE_LAYOUT=y
CONFIG_MPU_ALLOW_FLASH_WRITE=y

# Stack Support
CONFIG_MAIN_STACK_SIZE=2048
CONFIG_SYSTEM_WORKQUEUE_STACK_SIZE=2048

# Random Number Generation Support
CONFIG_TEST_RANDOM_GENERATOR=y
```

## src/main.c
```c
/*
 * Copyright (c) 2025
 * Regis Rousseau
 * Univ Lyon, INSA Lyon, Inria, CITI, EA3720
 * SPDX-License-Identifier: Apache-2.0
 */

//  ========== includes ====================================================================
#include "app_lorawan.h"
#include "app_rtc.h"

//  ========== globals =====================================================================
// define GPIO specifications for the LEDs used to indicate transmission (TX) and reception (RX)
static const struct gpio_dt_spec led_tx = GPIO_DT_SPEC_GET(LED_TX, gpios);
static const struct gpio_dt_spec led_rx = GPIO_DT_SPEC_GET(LED_RX, gpios);

//  ========== main ========================================================================
int8_t main(void)
{
	uint8_t payload[PAYLOAD_SIZE] = {0};

	// structure to hold simulated sensor data
	struct data_t {
		int32_t timestamp;
		int16_t vbat;  // battery voltage in millivolts
		int16_t temp;  // temperature in tenths of a degree Celsius
		int16_t hum;   // humidity as a percentage
		int16_t vadc;  // ADC voltage in millivolts
	} data;

	// configure LEDs for TX and RX indication
	gpio_pin_configure_dt(&led_tx, GPIO_OUTPUT_ACTIVE);
	gpio_pin_configure_dt(&led_rx, GPIO_OUTPUT_ACTIVE);
	gpio_pin_set_dt(&led_tx, 0);		// turn off TX LED
	gpio_pin_set_dt(&led_rx, 0);		// turn off TX LED

	// initialize LoRaWAN protocol and register the device
	int8_t ret = app_lorawan_init();
	if (ret != 1) {
		printk("failed to initialze LoRaWAN protocol\n");
		return 0;
	}

	// initialize DS3231 RTC device via I2C (Pins: SDA -> P0.09, SCL -> P0.0)
    const struct device *rtc_dev = app_rtc_init();
    if (!rtc_dev) {
        printk("failed to initialize RTC device\n");
        return 0;
    }

	// retrieve the current timestamp from the RTC device 
	struct tm new_time = {
        .tm_sec = 0,
        .tm_min = 0,
        .tm_hour = 12,
        .tm_mday = 30,
        .tm_mon = 3,   // April (0-based)
        .tm_year = 125, // 2025 (since 1900)
        .tm_wday = 3    // Wednesday
    };

	printk("Geophone Measurement Simulation and Process Information\n");
	
	// start the main loop for data simulation and transmission
	while (1) {

		// retrieve the current timestamp from the RTC device 
		if (app_rtc_set_time(rtc_dev, &new_time) == 0) {
			struct tm current_time;
			data.timestamp = app_rtc_get_time(rtc_dev, &current_time);
		} else {
			printk("RTC set time failed\n");
			k_sleep(K_SECONDS(10));
			continue;
		}

		// generate random simulated sensor data
		data.vbat = sys_rand16_get() % 101;            // battery voltage: 0-100
		data.temp = sys_rand16_get() % 201 - 100;      // temperature: -100 to 100
		data.hum = sys_rand16_get() % 101;             // humidity: 0-100
		data.vadc = sys_rand16_get() % 3301;           // ADC voltage: 0-3300 mV

		// add the timestamp to the start of the data buffer
		payload[0] = (data.timestamp >> 24) & 0xFF; // most significant byte
		payload[1] = (data.timestamp >> 16) & 0xFF;
		payload[2] = (data.timestamp >> 8) & 0xFF;
		payload[3] = data.timestamp & 0xFF;        // least significant byte
		
		// encode sensor data into the payload
        payload[4] = (data.vbat >> 8) & 0xFF;
        payload[5] = data.vbat & 0xFF;

        payload[6] = (data.temp >> 8) & 0xFF;
        payload[7] = data.temp & 0xFF;

        payload[8] = (data.hum >> 8) & 0xFF;
        payload[9] = data.hum & 0xFF;

        payload[10] = (data.vadc >> 8) & 0xFF;
        payload[11] = data.vadc & 0xFF;

		// indicate data transmission with the TX LED
		printk("sending random data...\n");
		gpio_pin_set_dt(&led_tx, 1);

		// send the payload over LoRaWAN (unconfirmed message)
		ret = lorawan_send(LORAWAN_PORT, payload, PAYLOAD_SIZE, LORAWAN_MSG_UNCONFIRMED);
		
		// handle transmission errors
		if (ret == -EAGAIN) {
			printk("LoRaWAN send failed (retry). error: %d\n", ret);
			gpio_pin_set_dt(&led_tx, 0);
			k_sleep(K_SECONDS(10));
			continue;
		}
		
		if (ret < 0) {
			printk("LoRaWAN send failed. error: %d. retrying\n", ret);
			gpio_pin_set_dt(&led_tx, 0);
        	k_sleep(K_SECONDS(10));
        	continue;
		}

		printk("data sent successfully!\n");
		gpio_pin_set_dt(&led_tx, 0);

		// wait before the next iteration
		k_sleep(DELAY);
	}
	return 0;
}
```

## src/app_lorawan.c
```c
/*
 * Copyright (c) 2025
 * Regis Rousseau
 * Univ Lyon, INSA Lyon, Inria, CITI, EA3720
 * SPDX-License-Identifier: Apache-2.0
 */

//  ========== includes ====================================================================
#include "app_lorawan.h"

//  ========== globals =====================================================================
static const struct gpio_dt_spec led_tx = GPIO_DT_SPEC_GET(LED_TX, gpios);
static const struct gpio_dt_spec led_rx = GPIO_DT_SPEC_GET(LED_RX, gpios);

// downlink callback
static void dl_callback(uint8_t port, bool data_pending, int16_t rssi, int8_t snr, uint8_t len, const uint8_t *data)
{
	printk("downlink data received: ");
    for(int8_t i=0; i < len; i++) {
		printk("%02X ", data[i]);
	}
    printk("\n");
	printk("port: %d, pending: %d, RSSI: %ddB, SNR: %dBm\n", port, data_pending, rssi, snr);
}

// ADR change callback
static void lorwan_datarate_changed(enum lorawan_datarate dr)
{
	uint8_t unused, max_size;

	lorawan_get_payload_sizes(&unused, &max_size);
	printk("new datarate: DR_%d, max payload: %d\n", dr, max_size);
}

//  ========== app_loarwan_init ============================================================
int8_t app_lorawan_init(void)
{
	struct lorawan_join_config join_cfg;

	uint8_t dev_addr[] = LORAWAN_DEV_ADDR;
	uint8_t app_skey[] = LORAWAN_APP_SKEY;
    uint8_t nwk_skey[] = LORAWAN_NWK_SKEY;
	uint8_t app_eui[]  = LORAWAN_DEV_EUI;

	printk("starting LoRaWAN node initialization\n");

    // retrieve the LoRa SX1276 device
	const struct device *lora_dev = DEVICE_DT_GET(DT_ALIAS(lora0));
	if (!device_is_ready(lora_dev)) {
		printk("%s: LoRaWAN device not ready\n", lora_dev->name);
		return 0;
	}

	printk("starting LoRaWAN stack\n");

    // set the region (Europe)
	int8_t ret = lorawan_set_region(LORAWAN_REGION_EU868);
	if (ret < 0) {
		printk("failed to start LoRaWAN stack. error: %d\n", ret);
		return 0;
	}

	// indicate device activity by toggling the transmission LED
	gpio_pin_set_dt(&led_tx, 1);

	// start the LoRaWAN stack
	ret = lorawan_start();
	if (ret < 0) {
		printk("failed to start LoRaWAN stack. error: %d\n", ret);
		return 0;
	} else {
			// allow some time for the stack to stabilize
			k_sleep(K_MSEC(500));
	}

	// enable Adaptive Data Rate (ADR) to optimize communication settings
    lorawan_enable_adr(true);

    // register downlink and data rate change callbacks for receiving messages and updates
	struct lorawan_downlink_cb downlink_cb = {
		.port = LW_RECV_PORT_ANY,
		.cb = dl_callback
	};
	lorawan_register_downlink_callback(&downlink_cb);
	lorawan_register_dr_changed_callback(lorwan_datarate_changed); 

	// configuration of lorawan network using ABP
    join_cfg.mode = LORAWAN_ACT_ABP;
    join_cfg.abp.dev_addr = dev_addr;
    join_cfg.abp.app_skey = app_skey;
    join_cfg.abp.nwk_skey = nwk_skey;
	join_cfg.abp.app_eui = app_eui;

	int8_t retry_count = 0;
	// attempt to join the LoRaWAN network using ABP
	do {
		printk("attempting to join LoRaWAN network using ABP\n");

		// indicate receiving activity by toggling the reception LED
		gpio_pin_set_dt(&led_rx, 1);

		ret = lorawan_join(&join_cfg);
		if (ret < 0) {
			if (ret == -ETIMEDOUT) {
				printk("join request timed out. retrying...\n");
			} else {
				printk("failed to join network. error: %d\n", ret);
			}
		}
		
		gpio_pin_set_dt(&led_rx, 0);

		if (retry_count > MAX_JOIN_ATTEMPTS) {
			printk("maximum retries reached. aborting.\n");
            return -1;
		}
		retry_count++;
		k_sleep(K_MSEC(10000));  // Wait before retrying

	} while (ret < 0);

	printk("successfully joined LoRaWAN network using ABP\n");
	// turn off LEDs to indicate the end of the process
	gpio_pin_set_dt(&led_tx, 0);
	gpio_pin_set_dt(&led_rx, 0);
	
    return 1;
}

  
    
```

## src/app_lorawan.h
```c
/*
 * Copyright (c) 2025
 * Regis Rousseau
 * Univ Lyon, INSA Lyon, Inria, CITI, EA3720
 * SPDX-License-Identifier: Apache-2.0
 */

#ifndef APP_LORAWAN_H
#define APP_LORAWAN_H

//  ========== includes ====================================================================
#include <zephyr/kernel.h>
#include <zephyr/device.h>
#include <zephyr/devicetree.h>
#include <zephyr/drivers/gpio.h>
#include <zephyr/drivers/lora.h>
#include <zephyr/lorawan/lorawan.h>
#include <zephyr/random/random.h>

//  ========== defines =====================================================================
#define LED_TX                  DT_ALIAS(ledtx)     // declared in device tree 
#define LED_RX                  DT_ALIAS(ledrx)     // declared in device tree
#define DELAY 			        K_MINUTES(2)   
#define PAYLOAD_SIZE            12

// customize based on network configuration
#define LORAWAN_DEV_ADDR		{ 0x26, 0x0B, 0x15, 0xAF }
#define LORAWAN_DEV_EUI			{ 0x70, 0xB3, 0xD5, 0x7E, 0xD0, 0x06, 0xD8, 0xDE }
#define LORAWAN_NWK_SKEY        { 0x7D, 0x04, 0x12, 0x67, 0x7E, 0xD4, 0xCC, 0x1B, 0xF5, 0xB3, 0xE7, 0xFC, 0xF1, 0xB9, 0xE5, 0xA2 }
#define LORAWAN_APP_SKEY		{ 0xE9, 0x4B, 0xCA, 0x98, 0x22, 0x78, 0x62, 0x1D, 0x26, 0xCA, 0xDF, 0x7D, 0x6D, 0xF4, 0x56, 0x23 }
#define LORAWAN_PORT            2       // application port
#define MAX_JOIN_ATTEMPTS       10      // limiting join attempts

//  ========== prototypes ==================================================================
int8_t app_lorawan_init(void);

#endif /* APP_LORAWAN_H */
```

## src/app_rtc.h
```c
/*
 * Copyright (c) 2025
 * Regis Rousseau
 * Univ Lyon, INSA Lyon, Inria, CITI, EA3720
 * SPDX-License-Identifier: Apache-2.0
 */

 #ifndef APP_RTC_H
 #define APP_RTC_H
 
//  ========== includes ====================================================================
#include <zephyr/kernel.h>
#include <zephyr/device.h>
#include <zephyr/devicetree.h>
#include <zephyr/drivers/i2c.h>
#include <zephyr/drivers/counter.h>
#include <time.h>
 
//  ========== defines =====================================================================
#define DS3231_I2C_ADDR 0x68
 
//  ========== prototypes ==================================================================
const struct device *app_rtc_init(void);
int8_t app_rtc_set_time(const struct device *i2c_dev, const struct tm *date_time);
int32_t app_rtc_get_time(const struct device *i2c_dev, struct tm *date_time);
uint8_t bcd_to_decimal(uint8_t val);
uint8_t decimal_to_bcd(uint8_t val);
 
#endif /* APP_RTC_H */
```
